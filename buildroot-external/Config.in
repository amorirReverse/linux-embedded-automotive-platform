## buildroot-external/Config.in
```kconfig
source "$BR2_EXTERNAL_AUTOMOTIVE_PLATFORM_PATH/package/linux-embedded-automotive-platform/Config.in"
```

## buildroot-external/package/linux-embedded-automotive-platform/Config.in
```kconfig
config BR2_PACKAGE_LINUX_EMBEDDED_AUTOMOTIVE_PLATFORM
	bool "Automotive platform"
	
	help
	  Automotive ECU simulation platform with engine, battery and gateway
	  applications, built with CMake.
```
